## components/convai_ws/Kconfig
```kconfig
menu "ConvAI audio codecs"

    config CONVAI_ENABLE_OPUS
        bool "Enable Opus codec"
        default y
        help
            Include the Opus codec (vendored opus-1.6.1, fixed-point CELT).
            Disable to save flash on builds that only need PCM/G.711/ADPCM.

endmenu

menu "ConvAI transport & buffers"

    config CONVAI_WS_TASK_STACK
        int "WebSocket client task stack (bytes)"
        default 4096

    config CONVAI_TX_QUEUE_FRAMES
        int "Uplink TX queue depth (frames, 768B each)"
        default 16
        help
            Absorbs network stalls: mic frames queue here while the sender
            task drains them. Full -> oldest frame dropped (counted), never
            blocks the recorder. 16 frames = 320ms of audio.

    config CONVAI_RX_RING_KB
        int "Downlink RX jitter ring size (KB)"
        default 24
        help
            Absorbs playback/system stalls: decoded TTS PCM is buffered
            here. Full -> oldest whole frame dropped (counted).
            24KB = 1.5s @8kHz / 0.75s @16kHz PCM16.

endmenu

menu "ConvAI transport security"

    config CONVAI_WSS_CA_BUNDLE
        bool "WSS: verify with built-in CA bundle"
        default y
        help
            When the server URL uses wss://, verify the server certificate
            against the ESP-IDF built-in CA bundle (public CAs).

    config CONVAI_WSS_SKIP_CN_CHECK
        bool "WSS: skip certificate common-name check"
        default n
        help
            Accept certificates whose CN/SAN does not match the host
            (useful for self-signed certs addressed by IP).

endmenu
```

## main/Kconfig.projbuild
```kconfig
menu "Goldie ESP32 Configuration"

    config GOLDIE_WIFI_SSID
        string "WiFi SSID"
        default "your_ssid"
        help
            WiFi network name the device connects to.

    config GOLDIE_WIFI_PASSWORD
        string "WiFi Password"
        default "your_password"
        help
            WiFi password.

    config GOLDIE_SERVER_URL
        string "ConvAI Gateway WebSocket URL"
        default "ws://192.168.1.100:9000/"
        help
            cloud_gateway WebSocket endpoint, e.g. ws://<host>:9000/

    config GOLDIE_PRODUCT_ID
        string "Product ID"
        default "your_product_id"

    config GOLDIE_PRODUCT_KEY
        string "Product Key"
        default "your_product_key"

    config GOLDIE_PRODUCT_SECRET
        string "Product Secret"
        default "your_product_secret"

    config GOLDIE_DEVICE_NAME
        string "Device Name"
        default "esp32s3-001"

    config GOLDIE_AGENT_ID
        string "Agent ID"
        default "your_agent_id"

endmenu
```

## sdkconfig.defaults
```kconfig
CONFIG_PARTITION_TABLE_CUSTOM=y
CONFIG_PARTITION_TABLE_CUSTOM_FILENAME="partitions.csv"
CONFIG_ESPTOOLPY_FLASHSIZE_4MB=y
CONFIG_MBEDTLS_SSL_IN_CONTENT_LEN=4096
CONFIG_MBEDTLS_SSL_OUT_CONTENT_LEN=4096
```
